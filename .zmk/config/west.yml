## config/west.yml
```yaml
manifest:
  remotes:
    - name: zmk-sofle-base
      url-base: https://github.com/a741725193
    # Additional modules containing boards/shields/custom code can be listed here as well
    # See https://docs.zephyrproject.org/3.2.0/develop/west/manifest.html#projects
  projects:
    - name: zmk-sofle
      remote: zmk-sofle-base
      revision: main
  self:
    path: config
```
